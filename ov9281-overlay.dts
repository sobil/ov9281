/dts-v1/;

/ {

	metadata {
		title = "Enable OV9281 camera module on VC I2C bus";
		compatible = "rockchip,rk3399";
		category = "camera";
		exclusive = "mipi_dphy_rx0";
		description = "Enable OV9281 camera module on VC I2C bus";
	};

	fragment@0 {
		target-path = [2f 00];

		__overlay__ {

			camera-pwdn-gpio {
				status = "okay";
				compatible = "regulator-fixed";
				regulator-name = "camera_pwdn_gpio";
				regulator-always-on;
				regulator-boot-on;
				enable-active-high;
				gpio = <0xffffffff 0x0d 0x00>;
				pinctrl-names = "default";
				pinctrl-0 = <0x01>;
				phandle = <0x07>;
			};

			external-camera-clock-24m {
				status = "okay";
				compatible = "fixed-clock";
				clock-frequency = <0x16e3600>;
				clock-output-names = "clk_cam_24m";
				#clock-cells = <0x00>;
				phandle = <0x02>;
			};
		};
	};

	fragment@1 {
		target = <0xffffffff>;

		__overlay__ {
			status = "okay";
			#address-cells = <0x01>;
			#size-cells = <0x00>;

			camera-ov9281@60 {
				status = "okay";
				compatible = "ovti,ov9281";
				reg = <0x60>;
				clocks = <0x02>;
				clock-names = "xvclk";
				rockchip,camera-module-index = <0x00>;
				rockchip,camera-module-facing = "back";
				rockchip,camera-module-name = "OV9281";
				rockchip,camera-module-lens-name = "default";
				phandle = <0x08>;

				port {

					endpoint {
						remote-endpoint = <0x03>;
						data-lanes = <0x01 0x02>;
						phandle = <0x04>;
					};
				};
			};
		};
	};

	fragment@2 {
		target = <0xffffffff>;

		__overlay__ {
			status = "okay";

			ports {
				#address-cells = <0x01>;
				#size-cells = <0x00>;

				port@0 {
					reg = <0x00>;
					#address-cells = <0x01>;
					#size-cells = <0x00>;

					endpoint@1 {
						reg = <0x01>;
						remote-endpoint = <0x04>;
						data-lanes = <0x01 0x02>;
						phandle = <0x03>;
					};
				};

				port@1 {
					reg = <0x01>;
					#address-cells = <0x01>;
					#size-cells = <0x00>;

					endpoint@0 {
						reg = <0x00>;
						remote-endpoint = <0x05>;
						phandle = <0x06>;
					};
				};
			};
		};
	};

	fragment@3 {
		target = <0xffffffff>;

		__overlay__ {
			status = "okay";
		};
	};

	fragment@4 {
		target = <0xffffffff>;

		__overlay__ {
			status = "okay";

			port {
				#address-cells = <0x01>;
				#size-cells = <0x00>;

				endpoint@0 {
					reg = <0x00>;
					remote-endpoint = <0x06>;
					phandle = <0x05>;
				};
			};
		};
	};

	fragment@5 {
		target = <0xffffffff>;

		__overlay__ {

			camera {

				cam-pwdn-gpio {
					rockchip,pins = <0x01 0x0d 0x00 0xffffffff>;
					phandle = <0x01>;
				};
			};
		};
	};

	__symbols__ {
		camera_pwdn_gpio = "/fragment@0/__overlay__/camera-pwdn-gpio";
		clk_cam_24m = "/fragment@0/__overlay__/external-camera-clock-24m";
		ucam_out0 = "/fragment@1/__overlay__/camera-ov9281@60/port/endpoint";
		mipi_in_ucam0 = "/fragment@2/__overlay__/ports/port@0/endpoint@1";
		dphy_rx0_out = "/fragment@2/__overlay__/ports/port@1/endpoint@0";
		isp0_mipi_in = "/fragment@4/__overlay__/port/endpoint@0";
		cam_pwdn_gpio = "/fragment@5/__overlay__/camera/cam-pwdn-gpio";
	};

	__fixups__ {
		gpio1 = "/fragment@0/__overlay__/camera-pwdn-gpio:gpio:0";
		i2c4 = "/fragment@1:target:0";
		mipi_dphy_rx0 = "/fragment@2:target:0";
		isp0_mmu = "/fragment@3:target:0";
		rkisp1_0 = "/fragment@4:target:0";
		pinctrl = "/fragment@5:target:0";
		pcfg_pull_up = "/fragment@5/__overlay__/camera/cam-pwdn-gpio:rockchip,pins:12";
	};

	__local_fixups__ {

		fragment@0 {

			__overlay__ {

				camera-pwdn-gpio {
					pinctrl-0 = <0x00>;
				};
			};
		};

		fragment@1 {

			__overlay__ {

				camera-ov9281@60 {
					clocks = <0x00>;

					port {

						endpoint {
							remote-endpoint = <0x00>;
						};
					};
				};
			};
		};

		fragment@2 {

			__overlay__ {

				ports {

					port@0 {

						endpoint@1 {
							remote-endpoint = <0x00>;
						};
					};

					port@1 {

						endpoint@0 {
							remote-endpoint = <0x00>;
						};
					};
				};
			};
		};

		fragment@4 {

			__overlay__ {

				port {

					endpoint@0 {
						remote-endpoint = <0x00>;
					};
				};
			};
		};
	};
};
